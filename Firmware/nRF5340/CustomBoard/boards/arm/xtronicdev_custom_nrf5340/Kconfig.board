## Firmware/nRF5340/CustomBoard/boards/arm/xtronicdev_custom_nrf5340/Kconfig.board
```kconfig
# Copyright (c) 2024 Nordic Semiconductor ASA
# SPDX-License-Identifier: Apache-2.0

config BOARD_XTRONICDEV_CUSTOM_NRF5340
	bool "XtronicDev_Custom_nRF5340"
	depends on SOC_NRF5340_CPUAPP_QKAA
```

## Firmware/nRF5340/CustomBoard/boards/arm/xtronicdev_custom_nrf5340/Kconfig.defconfig
```kconfig
# Copyright (c) 2024 Nordic Semiconductor ASA
# SPDX-License-Identifier: Apache-2.0

if BOARD_XTRONICDEV_CUSTOM_NRF5340

config BOARD
	default "xtronicdev_custom_nrf5340"


endif
```
